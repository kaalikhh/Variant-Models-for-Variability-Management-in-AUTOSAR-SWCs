AUTOSAR XML (schema 4-2-2)
standard types defined: Double, float64
package /VariantSubsystemModel2_pkg/VariantSubsystemModel2_dt/Ground
  constant specification DefaultInitValue_Double: value-spec=0
