AUTOSAR XML (schema 4-2-2)
package /VariantSubsystemModel2_pkg/VariantSubsystemModel2_imp
  swc implementation VariantSubsystemModel2: programming-language=C, sw-version=1.5.1, used-code-generator=Embedded Coder 6.12 (R2017a) 16-Feb-2017, vendor-id=0, behavior=VariantSubsystemModel2
    code-descriptors:
      code Code
        artifact-descriptors:
          short-label=VariantSubsystemModel2_c, category=SWSRC
          short-label=VariantSubsystemModel2_h, category=SWHDR
          short-label=rtwtypes_h, category=SWHDR
    resource consumption RsrcCons_VariantSubsystemModel2
