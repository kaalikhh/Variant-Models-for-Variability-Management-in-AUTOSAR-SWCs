AUTOSAR XML (schema 4-2-2)
standard types defined: Double, float64
package /variant_subsystems_pkg/variant_subsystems_dt/Ground
  constant specification DefaultInitValue_Double: value-spec=0
