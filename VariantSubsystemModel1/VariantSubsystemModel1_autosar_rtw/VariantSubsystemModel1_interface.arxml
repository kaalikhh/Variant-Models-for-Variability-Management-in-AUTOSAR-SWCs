AUTOSAR XML (schema 4-2-2)
package /variant_subsystems_pkg/variant_subsystems_if
  sender receiver interface Out1
    data Out1: category=VALUE, sw-calibration-access=READ-ONLY, type=Double
