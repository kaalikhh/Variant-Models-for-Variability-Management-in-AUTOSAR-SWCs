AUTOSAR XML (schema 4-2-2)
package /variant_subsystems_pkg/variant_subsystems_imp
  swc implementation variant_subsystems: programming-language=C, sw-version=1.54.1, used-code-generator=Embedded Coder 6.12 (R2017a) 16-Feb-2017, vendor-id=0, behavior=variant_subsystems
    code-descriptors:
      code Code
        artifact-descriptors:
          short-label=VariantSubsystemModel1_c, category=SWSRC
          short-label=VariantSubsystemModel1_h, category=SWHDR
          short-label=rtwtypes_h, category=SWHDR
    resource consumption RsrcCons_VariantSubsystemModel1
