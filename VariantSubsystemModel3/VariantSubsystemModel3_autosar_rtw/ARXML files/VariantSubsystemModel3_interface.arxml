AUTOSAR XML (schema 4-2-2)
package /VariantSubsystemModel3_pkg/VariantSubsystemModel3_if
  sender receiver interface Out1
    data Out1: category=VALUE, sw-calibration-access=READ-ONLY, type=Double
