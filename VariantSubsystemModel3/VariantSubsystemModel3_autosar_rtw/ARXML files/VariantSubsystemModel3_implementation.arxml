AUTOSAR XML (schema 4-2-2)
package /VariantSubsystemModel3_pkg/VariantSubsystemModel3_imp
  swc implementation VariantSubsystemModel3: programming-language=C, sw-version=1.2.1, used-code-generator=Embedded Coder 6.12 (R2017a) 16-Feb-2017, vendor-id=0, behavior=VariantSubsystemModel3
    code-descriptors:
      code Code
        artifact-descriptors:
          short-label=VariantSubsystemModel3_c, category=SWSRC
          short-label=VariantSubsystemModel3_h, category=SWHDR
          short-label=rtwtypes_h, category=SWHDR
    resource consumption RsrcCons_VariantSubsystemModel3
