AUTOSAR XML (schema 4-2-2)
standard types defined: Double, float64
package /VariantSubsystemModel3_pkg/VariantSubsystemModel3_dt/Ground
  constant specification DefaultInitValue_Double: value-spec=0
